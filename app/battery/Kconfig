## app/battery/Kconfig
```kconfig
menu "Battery Configuration"
config BATTERY
    bool "Enable BATTERY"
    default y
    help
        This enables BATTERY in the app
endmenu
```

## app/bt_service/Kconfig
```kconfig
menu "BT SERVICE Configuration"
config BT_SERVICE
    bool "Enable BT_SERVICE"
    default y
    help
        This enables BT_SERVICE in the app
endmenu
```

## app/sens_mgr/Kconfig
```kconfig
menu "SENS MGR Configuration"
config SENS_MGR
    bool "Enable SENS_MGR"
    default y
    help
        This enables SENS_MGR in the app
endmenu
```

## app/shell_cmd/Kconfig
```kconfig
menu "SHELL ENABLED Configuration"
config SHELL_ENABLED
    bool "Enable SHELL_ENABLED"
    default y
    help
        This enables SHELL_ENABLED in the app
endmenu
```

## app/wifi_service/Kconfig
```kconfig
menu "WIFI SERVICE Configuration"
config WIFI_SERVICE_ENABLED
    bool "Enable WIFI SERVICE_ENABLED"
    default y
    help
        This enables WIFI SERVICE_ENABLED in the app

config APP_WIFI_SSID
    string "Wi-Fi SSID"
    default "Disconnet"

config APP_WIFI_PASSWORD
    string "Wi-Fi password"
    default "qwerfdsa"

# Choose exactly one of these two
choice
    prompt "Wi-Fi security"
    default APP_WIFI_SECURITY_PSK
config APP_WIFI_SECURITY_OPEN
    bool "Open (no password)"
config APP_WIFI_SECURITY_PSK
    bool "WPA2/WPA3 PSK"
endchoice
endmenu
```
