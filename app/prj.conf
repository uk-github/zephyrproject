## CMakeLists.txt
```
cmake_minimum_required(VERSION 3.20.0)

find_package(Zephyr REQUIRED HINTS $ENV{ZEPHYR_BASE})
project(app)

include_directories(${CMAKE_CURRENT_SOURCE_DIR}/inc)
include_directories(${CMAKE_CURRENT_SOURCE_DIR}/bt_service/inc)
include_directories(${CMAKE_CURRENT_SOURCE_DIR}/battery/inc)
include_directories(${CMAKE_CURRENT_SOURCE_DIR}/sens_mgr/inc)
include_directories(${CMAKE_CURRENT_SOURCE_DIR}/shell_cmd/inc)
include_directories(${CMAKE_CURRENT_SOURCE_DIR}/wifi_service/inc)

if(CONFIG_BT_SERVICE)
add_subdirectory(bt_service)
endif()

if(CONFIG_BATTERY)
add_subdirectory(battery)
endif()

if(CONFIG_BATTERY)
add_subdirectory(sens_mgr)
endif()

if(CONFIG_SHELL_ENABLED)
add_subdirectory(shell_cmd)
endif()

if(CONFIG_WIFI_SERVICE_ENABLED)
add_subdirectory(wifi_service)
endif()

target_sources(app PRIVATE 
    src/main.c
)
```

## Kconfig
```
rsource "$ZEPHYR_BASE/Kconfig.zephyr"
rsource "bt_service/Kconfig"
rsource "battery/Kconfig"
rsource "sens_mgr/Kconfig"
rsource "shell_cmd/Kconfig"
rsource "wifi_service/Kconfig"
```

## prj.conf
```kconfig
CONFIG_PRINTK=y                                 # Enable printk for logging
CONFIG_CONSOLE=y
CONFIG_UART_CONSOLE=y
CONFIG_USB_CDC_ACM=y                            # If using native USB

CONFIG_MAIN_STACK_SIZE=8192
CONFIG_ESPTOOLPY_FLASHSIZE_16MB=y               # Set flash size to 16MB
CONFIG_SYSTEM_WORKQUEUE_STACK_SIZE=6144
CONFIG_THREAD_NAME=y

CONFIG_BT=y
CONFIG_BT_PERIPHERAL=y
CONFIG_BT_DEVICE_NAME="ESP32S3_BLE"
CONFIG_BT_ID_MAX=2
CONFIG_BT_GATT_DYNAMIC_DB=y
CONFIG_BT_SMP=y
CONFIG_BT_SETTINGS=y
CONFIG_BT_GATT_CACHING=y
CONFIG_BT_RX_STACK_SIZE=2048

CONFIG_STACK_CANARIES=y
CONFIG_STACK_USAGE=y

CONFIG_LOG=y

# application config
CONFIG_BT_SERVICE=y
CONFIG_BATTERY=y
CONFIG_SENS_MGR=y
CONFIG_SHELL_ENABLED=y
CONFIG_WIFI_SERVICE_ENABLED=y

# shell implementation
CONFIG_SHELL=y
CONFIG_SHELL_BACKEND_SERIAL=y
CONFIG_SHELL_CMDS=y
# optional 
CONFIG_SHELL_HISTORY=y
CONFIG_SHELL_HELP=y
CONFIG_SHELL_TAB=y


# Core networking
CONFIG_NETWORKING=y
CONFIG_NET_NATIVE=y
CONFIG_NET_IPV4=y
CONFIG_NET_IPV6=n
CONFIG_NET_DHCPV4=y

# Logging (handy for bringup)
CONFIG_NET_LOG=y
#CONFIG_WIFI_LOG_LEVEL_DBG=y
#CONFIG_NET_MGMT_EVENT_LOG_LEVEL_DBG=y
#CONFIG_LOG_DEFAULT_LEVEL=4

# Network Configuration
CONFIG_NET_CONFIG_AUTO_INIT=n
CONFIG_NET_CONNECTION_MANAGER=y
CONFIG_NET_DHCPV4_SERVER=y
CONFIG_NET_IF_MAX_IPV4_COUNT=2
CONFIG_NET_IF_MAX_IPV6_COUNT=2
CONFIG_NET_L2_ETHERNET=y
CONFIG_NET_MGMT=y
CONFIG_NET_MGMT_EVENT=y
CONFIG_NET_MGMT_EVENT_INFO=y
CONFIG_NET_MGMT_EVENT_QUEUE_SIZE=10
CONFIG_NET_MGMT_EVENT_STACK_SIZE=4096
CONFIG_NET_PKT_RX_COUNT=16
CONFIG_NET_PKT_TX_COUNT=16
CONFIG_NET_SOCKETS_SERVICE_STACK_SIZE=4096
CONFIG_NET_TCP=y
CONFIG_NET_UDP=y

# Wi-Fi + events
CONFIG_NET_L2_WIFI_MGMT=y
CONFIG_WIFI=y

# ESP32-S3 Wi-Fi driver
CONFIG_WIFI_ESP32=y

# App options (defined in Kconfig below)
CONFIG_APP_WIFI_SSID="Disconnet"
CONFIG_APP_WIFI_PASSWORD="qwerfdsa"
CONFIG_APP_WIFI_SECURITY_PSK=y
# If your network is open:
#CONFIG_APP_WIFI_SECURITY_OPEN=y
```

## src/main.c
```c
#include <zephyr/kernel.h>
#include <zephyr/sys/printk.h>
#include <stdio.h>
#include "loggers.h"
#include "msg_que.h"

#if CONFIG_BT_SERVICE
#include "bt_service.h"
#endif

#if CONFIG_BATTERY
#include "battery.h"
#endif

#if CONFIG_SENS_MGR
#include "sens_mgr.h"
#endif

#if CONFIG_WIFI_SERVICE_ENABLED
#include "wifi_service.h"
#endif

#define LOG_TAG "MAIN"

#define STACK_NAME(name)    name##_stack 
#define CB_NAME(name)       name##_th_cb
#define TH_NAME(name)       name##_th
#define INIT_TH_TABLE(name) { .stack_area = STACK_NAME(name), .stack_size = 1024, .cb = CB_NAME(name) }

#define INIT_FUNC(name)     name##_init
#define START_FUNC(name)    name##_start
#define INIT_MODULE(name)   { .init = INIT_FUNC(name), .start = START_FUNC(name) }

#define ARY_SZ(ARY)         sizeof(ARY) / sizeof(ARY[0])


K_MSGQ_DEFINE(main_msgq, sizeof(msg_t *), 10, 4);

typedef struct {
    k_tid_t tid;
    struct k_thread th;
    void *stack_area;
    size_t stack_size;
    void (*cb)(void *arg1, void *arg2, void *arg3);
} thread_info_t;

typedef struct __attribute__((packed)) {
    int (*init) (void);
    int (*start) (void);
} module_info_t;

#if CONFIG_BT_SERVICE
    K_THREAD_STACK_DEFINE(STACK_NAME(bt_service), 1024);
#endif
#if CONFIG_BATTERY
    K_THREAD_STACK_DEFINE(STACK_NAME(battery), 1024);
#endif

#if CONFIG_SENS_MGR
    K_THREAD_STACK_DEFINE(STACK_NAME(sens_mgr), 1024);
#endif

thread_info_t th_tble[] = {
#if CONFIG_BT_SERVICE
    INIT_TH_TABLE(bt_service),
#endif
#if CONFIG_BATTERY
    INIT_TH_TABLE(battery),
#endif

#if CONFIG_SENS_MGR
    INIT_TH_TABLE(sens_mgr),
#endif
};

module_info_t module_info[] = {
#if CONFIG_BT_SERVICE
    INIT_MODULE(bt_service),
#endif
#if CONFIG_BATTERY
    INIT_MODULE(battery),
#endif
#if CONFIG_SENS_MGR
    INIT_MODULE(sens_mgr),
#endif
#if CONFIG_WIFI_SERVICE_ENABLED
    INIT_MODULE(wifi_service),
#endif    
};

int main(void) {
    BEGIN();
    for (int i = 0; i < ARY_SZ(module_info); i++) {
        if (module_info[i].init) module_info[i].init();
    }

    for (int i = 0; i < ARY_SZ(th_tble); i++) {
        th_tble[i].tid = k_thread_create(&th_tble[i].th,
                         th_tble[i].stack_area, th_tble[i].stack_size, 
                         th_tble[i].cb, NULL, NULL, NULL, 
                         5, 0, K_NO_WAIT);
    }
    
    for (int i = 0; i < ARY_SZ(module_info); i++) {
        if (module_info[i].start) module_info[i].start();
    }

    while (1) {
        msg_t msg;
        if (k_msgq_get(&main_msgq, &msg, K_FOREVER) == 0) {
            log_d("Received message of type %d with ID %d", msg.cmd, msg.id);
        }
        k_sleep(K_MSEC(1000));
        log_d("Main th is running");
    }
    END();  
    return 0;
}
```

## inc/loggers.h
```c
#pragma once

#include <zephyr/kernel.h>
#include <zephyr/sys/printk.h>
#include <stdio.h>

#define LOG_LEVEL_DEBUG     (0)
#define LOG_LEVEL_INFO      (1)
#define LOG_LEVEL_WARN      (2)
#define LOG_LEVEL_ERROR     (3)
#define LOG_LEVEL_FATAL     (4)
#define LOG_OFF             (5)

#define LOG_LEVEL           (LOG_LEVEL_INFO)

#if LOG_LEVEL <= LOG_LEVEL_DEBUG
#define log_d(fmt, ...)     printk("[D] %s: %s(%d): " fmt "\n", LOG_TAG,  __func__, __LINE__, ##__VA_ARGS__)
#define log_i(fmt, ...)     printk("[I] %s: %s(%d): " fmt "\n", LOG_TAG,  __func__, __LINE__, ##__VA_ARGS__)
#define log_w(fmt, ...)     printk("[W] %s: %s(%d): " fmt "\n", LOG_TAG,  __func__, __LINE__, ##__VA_ARGS__)
#define log_e(fmt, ...)     printk("[E] %s: %s(%d): " fmt "\n", LOG_TAG,  __func__, __LINE__, ##__VA_ARGS__)
#define log_f(fmt, ...)     printk("[F] %s: %s(%d): " fmt "\n", LOG_TAG,  __func__, __LINE__, ##__VA_ARGS__)
#elif LOG_LEVEL <= LOG_LEVEL_INFO
#define log_d(fmt, ...)     do { } while (0)
#define log_i(fmt, ...)     printk("[I] %s: %s(%d): " fmt "\n", LOG_TAG,  __func__, __LINE__, ##__VA_ARGS__)
#define log_w(fmt, ...)     printk("[W] %s: %s(%d): " fmt "\n", LOG_TAG,  __func__, __LINE__, ##__VA_ARGS__)
#define log_e(fmt, ...)     printk("[E] %s: %s(%d): " fmt "\n", LOG_TAG,  __func__, __LINE__, ##__VA_ARGS__)
#define log_f(fmt, ...)     printk("[F] %s: %s(%d): " fmt "\n", LOG_TAG,  __func__, __LINE__, ##__VA_ARGS__)
#elif LOG_LEVEL <= LOG_LEVEL_WARN
#define log_d(fmt, ...)     do { } while (0)
#define log_i(fmt, ...)     do { } while (0)
#define log_w(fmt, ...)     printk("[W] %s: %s(%d): " fmt "\n", LOG_TAG,  __func__, __LINE__, ##__VA_ARGS__)
#define log_e(fmt, ...)     printk("[E] %s: %s(%d): " fmt "\n", LOG_TAG,  __func__, __LINE__, ##__VA_ARGS__)
#define log_f(fmt, ...)     printk("[F] %s: %s(%d): " fmt "\n", LOG_TAG,  __func__, __LINE__, ##__VA_ARGS__)
#elif LOG_LEVEL <= LOG_LEVEL_ERROR
#define log_d(fmt, ...)     do { } while (0)
#define log_i(fmt, ...)     do { } while (0)
#define log_w(fmt, ...)     do { } while (0)
#define log_e(fmt, ...)     printk("[E] %s: %s(%d): " fmt "\n", LOG_TAG,  __func__, __LINE__, ##__VA_ARGS__)
#define log_f(fmt, ...)     printk("[F] %s: %s(%d): " fmt "\n", LOG_TAG,  __func__, __LINE__, ##__VA_ARGS__)
#elif LOG_LEVEL <= LOG_LEVEL_FATAL
#define log_d(fmt, ...)     do { } while (0)
#define log_i(fmt, ...)     do { } while (0)
#define log_w(fmt, ...)     do { } while (0)
#define log_e(fmt, ...)     do { } while (0)
#define log_f(fmt, ...)     printk("[F] %s: %s(%d): " fmt "\n", LOG_TAG,  __func__, __LINE__, ##__VA_ARGS__)
#else
#define log_d(fmt, ...)     do { } while (0)
#define log_i(fmt, ...)     do { } while (0)
#define log_w(fmt, ...)     do { } while (0)
#define log_e(fmt, ...)     do { } while (0)
#define log_f(fmt, ...)     do { } while (0)
#endif

#if LOG_LEVEL <= LOG_LEVEL_DEBUG
#define BEGIN()     printk("[D] %s: %s(%d): BEGIN\n",   LOG_TAG,  __func__, __LINE__)
#define END()       printk("[D] %s: %s(%d): END\n",     LOG_TAG,  __func__, __LINE__)
#else
#define BEGIN()     do { } while (0)
#define END()       do { } while (0)
#endif 
```

## inc/msg_que.h
```c
#pragma once
#include <zephyr/kernel.h>

typedef struct __attribute__((packed)) {
    uint8_t cmd;
    uint8_t id;
    uint16_t len;
    uint8_t *data;
} msg_t;
```
